## sdkconfig.defaults
```kconfig
# IceSickle ESP-IDF Configuration
# ESP32-S3 specific settings

# Hardware RNG - critical for key generation
CONFIG_BOOTLOADER_RANDOM_ENABLE=y
CONFIG_ESP_SYSTEM_RNG_ENABLE=y

# Memory
CONFIG_ESP32S3_SPIRAM_SUPPORT=y
CONFIG_SPIRAM_MODE_OCT=y
CONFIG_SPIRAM_SPEED_80M=y

# Disable features we don't need (reduce attack surface)
CONFIG_BT_ENABLED=n
CONFIG_ESP_WIFI_ENABLED=n

# Logging
CONFIG_LOG_DEFAULT_LEVEL_INFO=y

# Security hardening
CONFIG_COMPILER_STACK_CHECK_MODE_STRONG=y
CONFIG_ESP_SYSTEM_MEMPROT_FEATURE=y
CONFIG_ESP_SYSTEM_MEMPROT_FEATURE_LOCK=y

# Watchdog
CONFIG_ESP_TASK_WDT_EN=y
CONFIG_ESP_TASK_WDT_TIMEOUT_S=10
```
